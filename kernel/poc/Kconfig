## kernel/poc/Kconfig
```kconfig
config POC_ETS
	bool "PoC - Event tracing system"
	depends on POC
	default y
	help
	  Trace PoC using the event tracing system.

config POC_SKTRC
	bool "PoC - SKTRC"
	depends on POC
	default y
	help
	  Trace PoC using the SKTRC.
```
